## conf/machine/imx6q-embedsky-e9.conf
```bitbake
#@TYPE: Machine
#@NAME: NXP i.MX6Q Embedsky E9
#@SOC: i.MX6Q
#@DESCRIPTION: Machine configuration for Waveshare i.MX6Q Embedsky E9
#@MAINTAINER: Ovidiu Mihalachi <ovidiu.mihalachi@gmail.com>

MACHINEOVERRIDES =. "mx6:mx6q:"

include conf/machine/include/imx-base.inc
include conf/machine/include/tune-cortexa9.inc

KERNEL_IMAGETYPE = "zImage"

PREFERRED_PROVIDER_u-boot ??= "u-boot-embedsky"
PREFERRED_PROVIDER_virtual/bootloader ??= "u-boot-embedsky"
UBOOT_SUFFIX = "imx"
#SPL_BINARY = "SPL"
#UBOOT_CONFIG ??= "spl"
#UBOOT_CONFIG[spl] = "mx6embedsky_defconfig,,u-boot.img"
UBOOT_MACHINE ?= "mx6embedsky_defconfig"

PREFERRED_PROVIDER_virtual/kernel ??= "linux-embedsky"
PREFERRED_PROVIDER_virtual/kernel_use-mainline-bsp ??= "linux-fslc"
KERNEL_DEVICETREE_use-mainline-bsp += "imx6q-sabresd.dtb"
KERNEL_DEVICETREE = "imx6q-embedsky.dtb"

IMAGE_FSTYPES += "tar.bz2 ext4 wic wic.bmap"
# wic support
WKS_FILE = "imx-uboot-bootpart.wks"

SERIAL_CONSOLE = "115200 ttymxc0"

MACHINE_FEATURES += " wifi bluetooth touchscreen"
```

## conf/machine/imx6q-embedsky.conf
```bitbake
#@TYPE: Machine
#@NAME: Embedsky i.MX6Q E9 Mini PC
#@SOC: i.MX6Q
#@DESCRIPTION: Machine configuration for Embedsky i.MX6Q E9 Mini PC
#@MAINTAINER: Ovidiu Mihalachi <ovidiu.mihalachi@gmail.com>

require conf/machine/include/imx-base.inc
require conf/machine/include/tune-cortexa9.inc

SOC_FAMILY = "mx6:mx6q"

SERIAL_CONSOLE = "115200 ttySC0"

KERNEL_IMAGETYPE = "zImage"
IMAGE_FSTYPES = "tar.bz2 ext4"

# U-Boot configuration
PREFERRED_PROVIDER_u-boot = "u-boot-embedsky"

UBOOT_CONFIG ??= "std"
UBOOT_CONFIG[std] = "mx6embedsky_config"

# Kernel configuration
PREFERRED_PROVIDER_virtual/kernel = "linux-embedsky"
PREFERRED_VERSION_linux-embedsky ?= "3.14.52"

MACHINE_FEATURES = ""
```
